/**  
 *@author ChangSu Nam
 *@UNI cn2521   
 *@Since Module 1, February 2021 
 *
 *This code displays poetry only consisting of onomatopoeia that describes rain.
 *The poem to be created is a visual poem that symbolizes rain falling from cloud.
 * 
 *Make sure all the display driver and pin connections are correct by
 *editing the User_Setup.h file in the TFT_eSPI library folder.
 *
 *Note that yield() or delay(0) must be called in long duration for/while
 *loops to stop the ESP8266 watchdog triggering.
 *
 #########################################################################
 ###### DON'T FORGET TO UPDATE THE User_Setup.h FILE IN THE LIBRARY ######
 #########################################################################
 *   
 *   
 *   
 **/


#include <TFT_eSPI.h> // Graphics and font library for ST7735 driver chip
#include <SPI.h>

TFT_eSPI tft = TFT_eSPI();  // Invoke library, pins defined in User_Setup.h

/**
 * onomatopoia the array of onomatopoeia and a blank space.
 * spaceLength the maximum length of the empty space that will fit the onomatopoeia on the screen when font size is 1
 */
char *onomatopoeia[] = {"drip ", "drop ", "split ", "splat ", "tap ", "pitter ", "patter ", ""}; //8 string elements, random number creater needs to create 0 to 7.
int spaceLength = 0;

void setup(void) {
  tft.init();
  tft.setRotation(1);
}


/**
 * This function  returns one of the string from the array of onomatopoeia. 
 * It sets spaceLength as (40 - length of chosen onomatopoeia). 
 * Note that 40 was used because 40 characters fits the in one line for screen size of 160 * 128, when font size is 1
 * 
 * @param randomNumber the random number created to choose which word to return from the array of onomatopoeia.
 * @return onomatopoeia the string of onomatopoeia
 */
char* createWords(int randomNumber){
    if(randomNumber == 0){
      spaceLength = 35;
     return onomatopoeia[0]; 
    }
    if(randomNumber == 1){
         spaceLength = 35;
         return onomatopoeia[1];  
    }
    if(randomNumber == 2){
      spaceLength = 34;
          return onomatopoeia[2]; 
    }
    if(randomNumber == 3){
       spaceLength = 34;
         return onomatopoeia[3];  
    }
    if(randomNumber == 4){
       spaceLength = 36;
            return onomatopoeia[4];  
    }
    if(randomNumber == 5){
       spaceLength = 33;
            return onomatopoeia[5];  
    }
    if(randomNumber == 6){
       spaceLength = 33;
           return onomatopoeia[6]; 
    }
     if(randomNumber == 7){
           spaceLength = 40;
           return onomatopoeia[7]; 
    }
       
}

/**
 * This function returns empty space, the length of the space is determined randomly.
 * Using random(maxLen), it creates a number from 0 to maxLen, which was then used in for loop to add empty spaces.
 * 
 * @param maxLen the maximum length of the empty string
 * @return str the string of empty spaces
 * 
 */
String createSpace(int maxLen){
  String str = "";
  int randomNumber = random(maxLen);
  for(int i = 0; i < randomNumber; i++) {
        str += " ";  
    }
    return str;
  
}
  

void loop(){
  /**
   * Setting for the Background of the screen. 
   * Color of background is set to black.
   */
  tft.fillScreen(TFT_BLACK);

  /**
   * Setting for the title of the poem.
   * Color of the text is set to white, and the size of the font is set to 1.
   * As a visual poem, the title represents the cloud in the sky.
   */
  tft.setTextColor(TFT_WHITE,TFT_BLACK);  tft.setTextSize(1);
  tft.println("RAIN RAIN RAIN RAIN RAIN RAIN RAIN RAIN ");


  /**
   * Setting for the content of the poem.
   * Color of the text is set to blue, and the size of the font is set to 1.
   * As a visual poem, the title represents the rain falling from the sky
   */
  tft.setTextColor(TFT_BLUE,TFT_BLACK);  tft.setTextSize(1); 

   /**
    * For font size of 1, 16 lines of 40 characters fill the entire screen for TTGO with size 160*128.
    * The for loop below prints 16 lines in total, filling up the whole screen.
    * On each line, empty spaces of random sizes are printed first with print(). Then the onomatopoeia chosen '
    * randomly is printed with println().
    * 
    * As a result, on each line, one onomatopoeia are printed anywhere between the beginning or the end of the line.
    * The word chosen, and the location of the word is generated by the code randomly. The content of the poem is different each time the code compiles.
    */
    
     for(int i=0; i< 16;i++){
        int randomNumberForWord = random(8);
        String poemToBePrinted = createWords(randomNumberForWord);
        tft.print(createSpace(spaceLength)); 
        tft.println(poemToBePrinted);
   }
   


  
//tft.println("                                        "); // 40 characters fit in one line when font size is 1
//tft.println("                                        ");
//tft.println("                                        ");
//tft.println("                                        ");
//tft.println("                                        ");
//tft.println("                                        ");
//tft.println("                                        ");
//tft.println("                                        ");
//tft.println("                                        ");
//tft.println("                                        ");
//tft.println("                                        ");
//tft.println("                                        ");
//tft.println("                                        ");
//tft.println("                                        ");
//tft.println("                                        ");
//tft.println("                                        ");//16 lines for font size 1


   while(1) yield();
}
